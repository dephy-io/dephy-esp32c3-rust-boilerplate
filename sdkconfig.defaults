## sdkconfig.defaults
```kconfig
# Rust often needs a bit of an extra main task stack size compared to C (the default is 3K)
# CONFIG_ESP_MAIN_TASK_STACK_SIZE=7000
CONFIG_ESP_MAIN_TASK_STACK_SIZE=36000
CONFIG_ESP_SYSTEM_EVENT_TASK_STACK_SIZE=36000

# Use this to set FreeRTOS kernel tick frequency to 1000 Hz (100 Hz by default).
# This allows to use 1 ms granuality for thread sleeps (10 ms by default).
CONFIG_FREERTOS_HZ=1000

CONFIG_BT_ENABLED=y
CONFIG_BT_BLE_ENABLED=y
CONFIG_BT_BLUEDROID_ENABLED=n
CONFIG_BT_NIMBLE_ENABLED=y
CONFIG_BT_GATTS_ENABLE=y
CONFIG_BT_GATTS_SEND_SERVICE_CHANGE_MODE=y
CONFIG_BT_BTC_TASK_STACK_SIZE=24000

CONFIG_BTDM_CTRL_MODE_BLE_ONLY=y
CONFIG_BTDM_CTRL_MODE_BR_EDR_ONLY=n
CONFIG_BTDM_CTRL_MODE_BTDM=n
CONFIG_BT_BLE_42_FEATURES_SUPPORTED=y

# Workaround for https://github.com/espressif/esp-idf/issues/7631
CONFIG_MBEDTLS_CERTIFICATE_BUNDLE=y
CONFIG_MBEDTLS_CERTIFICATE_BUNDLE_DEFAULT_FULL=y

CONFIG_ESP_COEX_SW_COEXIST_ENABLE=y
CONFIG_ESP_WIFI_DPP_SUPPORT=y
CONFIG_ESP_WIFI_DEBUG_PRINT=y
CONFIG_OPENTHREAD_ENABLED=y
CONFIG_OPENTHREAD_LOG_LEVEL_DYNAMIC=y

# CONFIG_OPENTHREAD_RADIO_NATIVE is not set
CONFIG_OPENTHREAD_RADIO_SPINEL_UART=y
# CONFIG_OPENTHREAD_RADIO_SPINEL_SPI is not set
CONFIG_OPENTHREAD_FTD=y
# CONFIG_OPENTHREAD_MTD is not set
# CONFIG_OPENTHREAD_RADIO is not set
CONFIG_OPENTHREAD_CLI=y
CONFIG_OPENTHREAD_DIAG=y
# CONFIG_OPENTHREAD_COMMISSIONER is not set
# CONFIG_OPENTHREAD_JOINER is not set
CONFIG_OPENTHREAD_SRP_CLIENT=y
CONFIG_OPENTHREAD_DNS_CLIENT=y
# CONFIG_OPENTHREAD_BORDER_ROUTER is not set
CONFIG_OPENTHREAD_NUM_MESSAGE_BUFFERS=65
# CONFIG_OPENTHREAD_DNS64_CLIENT is not set
CONFIG_OPENTHREAD_UART_BUFFER_SIZE=256
# CONFIG_OPENTHREAD_LINK_METRICS is not set
# CONFIG_OPENTHREAD_MACFILTER_ENABLE is not set
# CONFIG_OPENTHREAD_CSL_ENABLE is not set
CONFIG_ESP32_PTHREAD_TASK_STACK_SIZE_DEFAULT=36000
CONFIG_PTHREAD_TASK_STACK_SIZE_DEFAULT=36000

CONFIG_ESP_HTTP_CLIENT_ENABLE_BASIC_AUTH=y
CONFIG_MBEDTLS_DYNAMIC_BUFFER=y
CONFIG_MBEDTLS_DYNAMIC_FREE_PEER_CERT=y
CONFIG_MBEDTLS_DYNAMIC_FREE_CONFIG_DATA=y
CONFIG_MBEDTLS_DHM_C=y

CONFIG_LWIP_SNTP_MAX_SERVERS=4
# CONFIG_LWIP_DHCP_GET_NTP_SRV is not set
CONFIG_LWIP_SNTP_UPDATE_DELAY=3600000
# end of SNTP

CONFIG_LWIP_BRIDGEIF_MAX_PORTS=7
CONFIG_LWIP_ESP_LWIP_ASSERT=y
CONFIG_LWIP_SNTP_MAX_SERVERS=4
CONFIG_LWIP_SNTP_UPDATE_DELAY=3600000
CONFIG_LWIP_NETIF_API=y
CONFIG_LWIP_SO_REUSE=y
CONFIG_LWIP_SO_REUSE_RXTOALL=y

CONFIG_LWIP_DEBUG=y
LWIP_SNTP_DEBUG=y
CONFIG_LWIP_SNTP_DEBUG=y

ESP_IDF_COMP_ESP_NETIF_ENABLED=y
CONFIG_ESP_IDF_COMP_ESP_NETIF_ENABLED=y
SNTP_SERVER_DNS=0
CONFIG_SNTP_SERVER_DNS=0
```
